## conf/distro/indoorcomfortdist.conf
```bitbake
require conf/distro/poky.conf
# distro name
DISTRO = "indoorcomfortdist"
DISTRO_NAME = "indoorcomfortdist distribution"
DISTRO_VERSION = "1.0"
DISTRO_CODENAME = "idc"
DISTRO_FEATURES_append = " \
    systemd \
    virtualization \
"
DISTRO_FEATURES_BACKFILL_CONSIDERED += "sysvinit"
VIRTUAL-RUNTIME_init_manager = "systemd"
VIRTUAL-RUNTIME_initscripts = "systemd-compat-units"
SDK_VENDOR = "-indoorcomfortsdk"
SDK_VERSION := "${@'${DISTRO_VERSION}'.replace('snapshot-${DATE}','snapshot')}"
MAINTAINER = "indoorcomfortdist "
INHERIT += "buildhistory"
BUILDHISTORY_COMMIT = "1"
```

## conf/layer.conf
```bitbake
BBPATH .= ":${LAYERDIR}"

BBFILES += "${LAYERDIR}/recipes-*/*/*.bb \
            ${LAYERDIR}/recipes-*/*/*.bbappend"

BBFILE_COLLECTIONS += "indoorcomfort"
BBFILE_PATTERN_indoorcomfort := "^${LAYERDIR}/"
BBFILE_PRIORITY_indoorcomfort = "1337"

RESIN_COREBASE := '${@os.path.normpath("${LAYERDIR}/")}'

IMAGE_ROOTFS_SIZE ?= "0"
```
